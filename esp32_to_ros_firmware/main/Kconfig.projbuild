## esp32_to_ros_firmware/main/Kconfig.projbuild
```kconfig
menu "micro-ROS example-app settings"

    config MICRO_ROS_APP_STACK
        int "Stack the micro-ROS app (Bytes)"
        default 16000
        help
        Stack size in Bytes of the micro-ROS app

    config MICRO_ROS_APP_TASK_PRIO
        int "Priority of the micro-ROS app"
        default 5
        help
        Priority of micro-ros task higher value means higher priority

    config MICROROS_UART_TXD
        int "UART TXD GPIO"
        default 4
        help
        GPIO number for UART TXD

    config MICROROS_UART_RXD
        int "UART RXD GPIO"
        default 5
        help
        GPIO number for UART RXD

    config MICROROS_UART_RTS
        int "UART RTS GPIO"
        default -1
        help
        GPIO number for UART RTS

    config MICROROS_UART_CTS
        int "UART CTS GPIO"
        default -1
        help
        GPIO number for UART CTS
        
endmenu
```
